## apps/hello/boards/nrf9151dk_nrf9151_ns.conf
```kconfig
# Synchronous logging so early output/faults are visible immediately
CONFIG_LOG_MODE_IMMEDIATE=y
```

## tests/fsm/testcase.yaml
```yaml
# Twister metadata (future CI); `make fsmtest` builds and runs it directly.
tests:
  tracker.loc_fsm:
    platform_allow:
      - native_sim/native/64
    tags:
      - fsm
```

## west.yml
```yaml
# Freestanding NCS (cellular) application = west manifest repo (T2 topology).
# Imports sdk-nrf v3.4.0 but trims to a minimal cellular / nrf9151 ns set
# via name-allowlist so contributors don't pull the whole SDK.
manifest:
  self:
    # west clones the manifest repo here, under the workspace root. setup.sh
    # derives its REPO_DIR from this path -- keep the two in step.
    path: nrf9151-tracker

  remotes:
    - name: ncs
      url-base: https://github.com/nrfconnect

  projects:
    - name: nrf
      remote: ncs
      repo-path: sdk-nrf
      revision: v3.4.0
      clone-depth: 1
      import:
        # Only these projects (and their required deps) are cloned.
        # NCS-level + a subset of zephyr modules needed for nrf9151 ns.
        name-allowlist:
          # zephyr RTOS fork
          - zephyr
          # NCS crypto / TF-M / modem stack
          - nrfxlib
          - trusted-firmware-m
          - mbedtls
          - oberon-psa-crypto
          - qcbor
          - t_cose
          - mcuboot
          # zephyr modules (must also be in sdk-nrf's zephyr allowlist)
          - hal_nordic
          - cmsis
          - cmsis_6
          - picolibc
          - segger
          - nanopb        # protobuf codegen + runtime for the v3 wire protocol
          - zcbor
          - tf-psa-crypto
```
