## CMakeLists.txt
```
# SPDX-License-Identifier: Apache-2.0
cmake_minimum_required(VERSION 3.20.0)
find_package(Zephyr REQUIRED HINTS $ENV{ZEPHYR_BASE})
project(atprobe)
target_sources(app PRIVATE src/main.c)
```

## prj.conf
```kconfig
# TF-M: minimal profile (no bootloader partition) — matches the tracker app.
CONFIG_TFM_PROFILE_TYPE_MINIMAL=y

# TF-M builds hard-float ("Float ABI: Hard" in its banner); a soft-float
# app HardFaults at the NS boundary. Field lesson: this app's first flash
# crashed before the Zephyr banner.
CONFIG_FPU=y

CONFIG_LOG=y
CONFIG_LOG_MODE_IMMEDIATE=y
CONFIG_UART_INTERRUPT_DRIVEN=y

# Modem + the `at` shell passthrough — and NOTHING that drives the radio.
# No link control, no GNSS, no sockets: manual procedures like the
# AT+COPS=? carrier scan get the modem to themselves.
CONFIG_NRF_MODEM_LIB=y
CONFIG_SHELL=y
CONFIG_AT_SHELL=y

# AT syntax is full of `?`, which the Zephyr shell treats as a wildcard
# and eats before the at command sees it (field lesson: the scan command
# silently became a usage printout). No wildcards on a probe console.
CONFIG_SHELL_WILDCARD=n

CONFIG_HEAP_MEM_POOL_SIZE=8192
```

## boards/nrf9151dk_nrf9151_ns.overlay
```dts
/* No MCUboot — TF-M boots directly */
#include <samples/cellular/nrf91_no_bootloader_partitions.dtsi>
#include <samples/cellular/nrf91_sram_partitions.dtsi>
```

## src/main.c
```c
/*
 * atprobe: a bare AT console on the modem — nothing else runs.
 *
 * The tracker app owns the radio (FSM re-attach, GNSS duty cycle), which
 * starves or aborts long manual procedures: a 20-minute AT+COPS=? under
 * the live tracker never answered (2026-07-12). This app initializes the
 * modem library and then does nothing; the shell's `at` command is the
 * only radio user on the board.
 *
 * Usage over `make uart`:
 *   at AT+CFUN=1       radio on (the scan needs it)
 *   at AT+COPS=?       manual carrier scan, takes minutes;
 *                      AcT 7 = LTE-M, 9 = NB-IoT
 *   at AT%XMONITOR     serving-cell detail
 *   at AT+CFUN=0       radio off (persists modem state)
 */
#include <zephyr/kernel.h>
#include <zephyr/logging/log.h>
#include <modem/nrf_modem_lib.h>

LOG_MODULE_REGISTER(atprobe, LOG_LEVEL_INF);

int main(void)
{
	int err = nrf_modem_lib_init();

	if (err) {
		LOG_ERR("modem lib init: %d", err);
		return 0;
	}
	LOG_INF("atprobe ready — modem idle. Radio on: at AT+CFUN=1");
	return 0;
}
```
